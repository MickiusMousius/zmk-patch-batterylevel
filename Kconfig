## dts/bindings/sensor/zmk,battery-nrf-vddh-curve.yaml
```yaml
# Copyright (c) 2021 The ZMK Contributors
# SPDX-License-Identifier: MIT

description: |
  Battery SoC monitoring using a voltage divider, converting voltage
  to percent through a LiPo discharge-curve lookup.

compatible: "zmk,battery-voltage-divider-curve"

include: sensor-device.yaml

properties:
  io-channels:
    required: true
    description: ADC channel for the battery voltage

  output-ohms:
    type: int
    required: true
    description: Resistance of the lower leg of the voltage divider

  full-ohms:
    type: int
    required: true
    description: Total resistance of the voltage divider
```

## src/sensors/Kconfig
```kconfig
DT_COMPAT_ZMK_BATTERY_NRF_VDDH_CURVE := zmk,battery-nrf-vddh-curve
DT_COMPAT_ZMK_BATTERY_VOLTAGE_DIVIDER_CURVE := zmk,battery-voltage-divider-curve

config ZMK_BATTERY_NRF_VDDH_CURVE
    bool
    default $(dt_has_compat,$(DT_COMPAT_ZMK_BATTERY_NRF_VDDH_CURVE))
    select ADC
    select ZMK_BATTERY
    depends on SENSOR

config ZMK_BATTERY_VOLTAGE_DIVIDER_CURVE
    bool
    default $(dt_has_compat,$(DT_COMPAT_ZMK_BATTERY_VOLTAGE_DIVIDER_CURVE))
    select ADC
    select ZMK_BATTERY
    depends on SENSOR
```
